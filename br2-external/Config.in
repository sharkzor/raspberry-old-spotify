## br2-external/Config.in
```kconfig
source "$BR2_EXTERNAL_SPOTIFYPI_PATH/package/librespot/Config.in"
source "$BR2_EXTERNAL_SPOTIFYPI_PATH/package/camilladsp/Config.in"
source "$BR2_EXTERNAL_SPOTIFYPI_PATH/package/soloist/Config.in"
source "$BR2_EXTERNAL_SPOTIFYPI_PATH/package/spotifypi/Config.in"
```

## br2-external/configs/spotifypi_soloist_rpi2_defconfig
```kconfig
# SpotifyPi (Spotify Soloist variant) - Raspberry Pi 2 (32-bit, Cortex-A7)
BR2_arm=y
BR2_cortex_a7=y
BR2_ARM_FPU_NEON_VFPV4=y
BR2_TOOLCHAIN_EXTERNAL=y
BR2_TOOLCHAIN_EXTERNAL_BOOTLIN=y
BR2_TOOLCHAIN_EXTERNAL_BOOTLIN_ARMV7_EABIHF_GLIBC_STABLE=y
BR2_GLOBAL_PATCH_DIR="board/raspberrypi/patches"
BR2_OPTIMIZE_2=y

# System
BR2_TARGET_GENERIC_HOSTNAME="spotifypi"
BR2_TARGET_GENERIC_ISSUE="SpotifyPi"
BR2_TARGET_GENERIC_ROOT_PASSWD="spotifypi"
# BR2_TARGET_GENERIC_REMOUNT_ROOTFS_RW is not set
# BR2_TARGET_GENERIC_GETTY is not set
BR2_ROOTFS_DEVICE_CREATION_DYNAMIC_MDEV=y
BR2_SYSTEM_DHCP=""
BR2_ROOTFS_OVERLAY="$(BR2_EXTERNAL_SPOTIFYPI_PATH)/board/spotifypi/rootfs-overlay $(BR2_EXTERNAL_SPOTIFYPI_PATH)/board/spotifypi/rootfs-overlay-soloist"
BR2_ROOTFS_POST_BUILD_SCRIPT="$(BR2_EXTERNAL_SPOTIFYPI_PATH)/board/spotifypi/post-build.sh"
BR2_ROOTFS_POST_IMAGE_SCRIPT="$(BR2_EXTERNAL_SPOTIFYPI_PATH)/board/spotifypi/post-image.sh"

# Kernel (Raspberry Pi fork, same revision as upstream raspberrypi2_defconfig)
BR2_LINUX_KERNEL=y
BR2_LINUX_KERNEL_CUSTOM_TARBALL=y
BR2_LINUX_KERNEL_CUSTOM_TARBALL_LOCATION="$(call github,raspberrypi,linux,21b410140c47ffab5668399f6f143c7d7b935c8b)/linux-21b410140c47ffab5668399f6f143c7d7b935c8b.tar.gz"
BR2_LINUX_KERNEL_DEFCONFIG="bcm2709"
BR2_LINUX_KERNEL_CONFIG_FRAGMENT_FILES="$(BR2_EXTERNAL_SPOTIFYPI_PATH)/board/spotifypi/linux.fragment"
BR2_LINUX_KERNEL_DTS_SUPPORT=y
BR2_LINUX_KERNEL_INTREE_DTS_NAME="broadcom/bcm2709-rpi-2-b broadcom/bcm2710-rpi-2-b"
BR2_LINUX_KERNEL_NEEDS_HOST_OPENSSL=y

# Userspace
BR2_PACKAGE_BUSYBOX_CONFIG_FRAGMENT_FILES="$(BR2_EXTERNAL_SPOTIFYPI_PATH)/board/spotifypi/busybox.fragment"
BR2_PACKAGE_BUSYBOX_SHOW_OTHERS=y
BR2_PACKAGE_BUSYBOX_WATCHDOG=y
# BR2_PACKAGE_IFUPDOWN_SCRIPTS is not set
BR2_PACKAGE_ALSA_UTILS=y
BR2_PACKAGE_ALSA_UTILS_AMIXER=y
BR2_PACKAGE_ALSA_UTILS_APLAY=y
BR2_PACKAGE_ALSA_UTILS_SPEAKER_TEST=y
BR2_PACKAGE_DROPBEAR=y
BR2_PACKAGE_KMOD=y
BR2_PACKAGE_KMOD_TOOLS=y
BR2_PACKAGE_XZ=y
BR2_PACKAGE_PULSEAUDIO=y
BR2_PACKAGE_PULSEAUDIO_DAEMON=y
BR2_PACKAGE_SOLOIST=y
BR2_PACKAGE_CAMILLADSP=y
BR2_PACKAGE_SPOTIFYPI=y

# Firmware (cut-down variant: gpu_mem=16, no camera/codec blobs)
BR2_PACKAGE_RPI_FIRMWARE=y
BR2_PACKAGE_RPI_FIRMWARE_BOOTCODE_BIN=y
BR2_PACKAGE_RPI_FIRMWARE_VARIANT_PI_CD=y
BR2_PACKAGE_RPI_FIRMWARE_CONFIG_FILE="$(BR2_EXTERNAL_SPOTIFYPI_PATH)/board/spotifypi/config.txt"
BR2_PACKAGE_RPI_FIRMWARE_CMDLINE_FILE="$(BR2_EXTERNAL_SPOTIFYPI_PATH)/board/spotifypi/cmdline.txt"
BR2_PACKAGE_RPI_FIRMWARE_INSTALL_DTB_OVERLAYS=y

# Images (PulseAudio and the Soloist binary need more room than librespot)
BR2_TARGET_ROOTFS_EXT2=y
BR2_TARGET_ROOTFS_EXT2_4=y
BR2_TARGET_ROOTFS_EXT2_SIZE="256M"
# BR2_TARGET_ROOTFS_TAR is not set
BR2_PACKAGE_HOST_DOSFSTOOLS=y
BR2_PACKAGE_HOST_GENIMAGE=y
BR2_PACKAGE_HOST_KMOD_XZ=y
BR2_PACKAGE_HOST_MTOOLS=y
BR2_PACKAGE_HOST_E2FSPROGS=y
BR2_PACKAGE_HOST_GO_BIN=y
```

## br2-external/package/camilladsp/Config.in
```kconfig
config BR2_PACKAGE_CAMILLADSP
	bool "camilladsp"
	depends on BR2_PACKAGE_HOST_RUSTC_TARGET_ARCH_SUPPORTS
	depends on BR2_TOOLCHAIN_HAS_THREADS
	select BR2_PACKAGE_HOST_RUSTC
	select BR2_PACKAGE_ALSA_LIB
	select BR2_PACKAGE_ALSA_LIB_PCM
	select BR2_PACKAGE_ALSA_LIB_MIXER
	help
	  Audio DSP engine (used here for parametric EQ). Built with
	  the ALSA backend only, without the websocket server.

	  https://github.com/HEnquist/camilladsp
```

## br2-external/package/librespot/Config.in
```kconfig
config BR2_PACKAGE_LIBRESPOT
	bool "librespot"
	depends on BR2_PACKAGE_HOST_RUSTC_TARGET_ARCH_SUPPORTS
	depends on BR2_TOOLCHAIN_HAS_THREADS
	select BR2_PACKAGE_HOST_RUSTC
	select BR2_PACKAGE_ALSA_LIB
	select BR2_PACKAGE_ALSA_LIB_PCM
	select BR2_PACKAGE_ALSA_LIB_MIXER
	help
	  Open source Spotify Connect client (ALSA backend, built-in
	  mDNS discovery, rustls TLS with compiled-in root certs).

	  https://github.com/librespot-org/librespot
```

## br2-external/package/soloist/Config.in
```kconfig
config BR2_PACKAGE_SOLOIST
	bool "soloist"
	depends on BR2_arm
	depends on BR2_ARM_EABIHF
	depends on BR2_TOOLCHAIN_USES_GLIBC # needs GLIBC_2.38 symbols
	depends on BR2_PACKAGE_PULSEAUDIO_HAS_ATOMIC # PulseAudio's own requirements,
	depends on BR2_USE_MMU                       # which select does not carry over
	depends on BR2_USE_WCHAR
	depends on BR2_TOOLCHAIN_HAS_THREADS
	depends on !BR2_STATIC_LIBS
	select BR2_PACKAGE_PULSEAUDIO
	select BR2_PACKAGE_PULSEAUDIO_DAEMON
	help
	  Spotify Soloist: Spotify Connect client (prebuilt, proprietary).
	  Plays through PulseAudio. Builds expire 90 days after they are
	  made, and the binary may not be redistributed.

	  https://developer.spotify.com/documentation/soloist
```

## br2-external/package/spotifypi/Config.in
```kconfig
config BR2_PACKAGE_SPOTIFYPI
	bool "spotifypi"
	depends on BR2_PACKAGE_HOST_GO_TARGET_ARCH_SUPPORTS
	depends on BR2_TOOLCHAIN_HAS_THREADS
	select BR2_PACKAGE_HOST_GO
	help
	  Web configuration UI and process launcher for librespot and
	  CamillaDSP.
```
